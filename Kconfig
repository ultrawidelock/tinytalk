## Kconfig
```kconfig
# tinytalk: a hand-written minimal Matter node. Distinct from the Nordic/CHIP
# Matter stack: it exists because CHIP does not fit a 512 KB / 128 KB part.

config TINYTALK
	bool "Hand-written minimal Matter node"
	# tm_device_id(), which seeds the serial number.
	select HWINFO
	help
	  Compile the from-scratch Matter protocol code: TLV codec, message and
	  exchange layers, MRP, and the small cluster surface Apple Home
	  actually exercises.

	  This is NOT a certified Matter stack and does not aim to be.

choice TINYTALK_SPAKE2P
	prompt "SPAKE2+ P-256 backend"
	depends on TINYTALK
	default TINYTALK_SPAKE2P_TINYPSA if TINYPSA
	default TINYTALK_SPAKE2P_OBERON if NRF_SECURITY
	default TINYTALK_SPAKE2P_MBEDTLS

config TINYTALK_SPAKE2P_TINYPSA
	bool "tinypsa (backends/tinypsa)"
	depends on TINYPSA
	help
	  Forward the four primitives to tinypsa's tinypsa_spake2p_p256_*,
	  which follow nrf_oberon's contract. For an image whose PSA Crypto
	  provider is tinypsa, where nrf_security and Mbed TLS ECP are absent.

config TINYTALK_SPAKE2P_OBERON
	bool "nrf_oberon (nRF Connect SDK, Nordic parts only)"
	help
	  Link the four ocrypto_spake2p_p256_* primitives from nrf_oberon,
	  which nrf_security already links when its PSA driver is the oberon
	  one. No code; see backends/oberon/oberon.cmake.

config TINYTALK_SPAKE2P_MBEDTLS
	bool "Mbed TLS 3.6 ECP (backends/mbedtls)"
	help
	  The same four primitives on Mbed TLS ECP, for any part. Needs
	  MBEDTLS_ECP_C, MBEDTLS_ECP_DP_SECP256R1_ENABLED and
	  MBEDTLS_PSA_CRYPTO_C in the Mbed TLS configuration.

endchoice

config TINYTALK_DOOR_LOCK
	bool "Door Lock cluster module (clusters/door_lock)"
	depends on TINYTALK
	help
	  A Door Lock cluster with no optional features, for an application
	  endpoint: LockState, LockDoor/UnlockDoor, AutoRelockTime and the
	  LockOperation event. The application provides
	  tm_door_lock_actuate(). See include/tinytalk/tm_door_lock.h.

config TINYTALK_EVENTS
	bool "Interaction Model events (the LockOperation event)"
	depends on TINYTALK
	default y
	help
	  Record events (tm_event_emit()) and report them to reads and
	  subscriptions that ask. With this off tm_event_emit() records
	  nothing, EventRequests and EventFilters are read past like any
	  unknown field, and no report carries an EventReports array.

	  Saves 2,016 B of flash and 1,088 B of RAM
	  (decawave_dwm3001cdk, samples/door-lock, LTO on, measured
	  2026-10-16).

	  Risk: Apple Home subscribes to Door Lock events, and the Door Lock
	  cluster spec makes LockOperation mandatory. A controller that asks
	  for events is answered with none, as if nothing had happened. Off is
	  untested on hardware.

config TINYTALK_ADMIN_COMMANDS
	bool "AdministratorCommissioning commands (OpenCommissioningWindow)"
	depends on TINYTALK
	default y
	help
	  Let a controller open a commissioning window: OpenCommissioningWindow
	  with its own verifier, OpenBasicCommissioningWindow and
	  RevokeCommissioning. With this off the cluster and its attributes
	  stay, all three commands answer UNSUPPORTED_COMMAND, and only
	  matter_commission_open_window() (a local gesture) opens a window.

	  Saves 528 B of flash and no RAM
	  (decawave_dwm3001cdk, samples/door-lock, LTO on, measured
	  2026-10-16).

	  Risk: OpenCommissioningWindow is mandatory in the cluster, which is
	  mandatory on the Root Node, and it is how one ecosystem shares the
	  lock with another (Apple Home "Turn On Pairing Mode"). Off is
	  untested on hardware.

config TINYTALK_SUB_RESUME
	bool "Keep subscriptions across a reboot"
	depends on TINYTALK
	default y
	help
	  Store each subscription in tm_kv and rebind it to the controller's
	  next CASE session after a reboot (see sub_resume_for() in
	  src/matter_commission.c). With this off a reboot ends every
	  subscription and nothing is stored.

	  Saves 996 B of flash and 128 B of RAM
	  (decawave_dwm3001cdk, samples/door-lock, LTO on, measured
	  2026-10-16).

	  Risk: a controller does not re-subscribe until its own liveness
	  timer expires. Measured 2026-08-02 without it: after every reboot the
	  Apple Home tile sat on "Unlocking" for minutes. Off is untested on
	  hardware in this tree.

# ---- the Zephyr port (ports/zephyr) ------------------------------------------

if TINYTALK

module = TINYTALK
module-str = tinytalk
source "subsys/logging/Kconfig.template.log_config"

config TINYTALK_HAS_BLE
	bool
	help
	  A matter_ble.h provider is linked.

config TINYTALK_HAS_THREAD
	bool
	help
	  A matter_thread.h provider is linked.

config TINYTALK_BLE
	bool "BLE commissioning: the 0xFFF6 service over BTP"
	# The framing itself is in the core (src/) and has no Zephyr
	# dependency; this brings in the Zephyr-side adapter that carries it.
	depends on BT_PERIPHERAL
	select TINYTALK_HAS_BLE
	help
	  Compile the 0xFFF6 service (C1 write, C2 indicate) and the BTP glue
	  that turns it into a Matter message transport (matter_ble.h).
	  It is one provider of matter_ble.h, on the Zephyr Bluetooth host.
	  Without it another module or the application provides matter_ble.h;
	  a module that does selects TINYTALK_HAS_BLE and depends on
	  !TINYTALK_BLE.

	  It advertises when the application calls matter_ble_advertise().
	  An application that owns the single advertising set asks this
	  transport for the commissionable payload instead
	  (matter_ble_zephyr.h) -- see TINYTALK_DISCRIMINATOR.

config TINYTALK_THREAD
	bool "Matter over Thread: OpenThread, SRP and UDP 5540"
	depends on OPENTHREAD
	select TINYTALK_HAS_THREAD
	help
	  Compile the Thread transport (matter_thread.h): the node joins the
	  Thread network a commissioner hands it, registers its operational
	  service over SRP and carries Matter over UDP on port 5540. It is
	  one provider of matter_thread.h, on OpenThread. Without it another
	  module or the application provides matter_thread.h; a module that
	  does selects TINYTALK_HAS_THREAD and depends on !TINYTALK_THREAD.

config TINYTALK_DISCRIMINATOR
	hex "Matter setup discriminator, 12-bit"
	default 0xF00
	range 0x000 0xFFF
	help
	  Goes out in the commissionable advertisement, and a commissioner uses
	  it to pick this device out of everything else advertising 0xFFF6. It
	  must match the discriminator encoded in the setup code the user enters
	  or the phone will never connect.

config TINYTALK_VENDOR_ID
	hex "Matter vendor ID"
	default 0xFFF1
	help
	  0xFFF1 is CHIP's test vendor. A real product needs an allocated one;
	  a phone will commission a test VID but marks the result uncertified.

config TINYTALK_PRODUCT_ID
	hex "Matter product ID"
	default 0x8001

config TINYTALK_SPAKE2P_VERIFIER
	string "SPAKE2+ verifier, hex: w0 (32 B) then L (65 B)"
	default "ca92f10ad437760cc8948aefe2d09f142bc1a363824a0079a63e6df097575bb5043609715ad65a53cd3c18a0f80011bf09dbbfbd9453c2b00eed286f5275ecaae60a2e896837995232334c319994d790ee2d09fe5cb4a229503234f8479eb3d308"
	help
	  What the device stores INSTEAD of the setup passcode. Someone who reads
	  this out of flash can verify a commissioner that knows the passcode and
	  cannot impersonate one, which is the point of SPAKE2+'s augmented form.

	  Generate with scripts/spake2p_verifier.py --passcode <p>, which prints
	  this and the two options below. It must be derived from the
	  same passcode, salt and iteration count as the two options below --
	  nothing on the device can check that it was, and a mismatched set fails
	  at Pake3 looking exactly like a wrong passcode.

	  IT IS ONE PAIRING FOR EVERY BOARD BUILT FROM THIS TREE. If the lock
	  guards anything, generate your own with the script and rebuild.

config TINYTALK_SETUP_PASSCODE
	int "Setup passcode the verifier above was derived from"
	default 58490394
	range 1 134217727
	help
	  The number a user would type into Apple Home. No C file in the module
	  reads it, so the passcode stays out of a module-only image exactly as
	  the augmented SPAKE2+ form intends.

	  samples/door-lock runs scripts/spake2p_verifier.py --from-config at
	  build time: it re-derives the verifier from this passcode, refuses to
	  continue if the two disagree, and compiles the 11-digit manual code
	  into the sample's boot log.

	  Change it and CONFIG_TINYTALK_SPAKE2P_VERIFIER together, both from
	  one run of scripts/spake2p_verifier.py --passcode <p>.

config TINYTALK_SPAKE2P_SALT
	string "SPAKE2+ salt, hex (16 to 32 bytes)"
	default "04f7398d5b49b5b5db8a5e61c8aece1d1a230e3b9085199d854ef034fd30a89b"
	help
	  Sent to the commissioner in PBKDFParamResponse so it can repeat the
	  derivation.

config TINYTALK_SPAKE2P_ITERATIONS
	int "SPAKE2+ PBKDF2 iterations"
	default 20000
	range 1000 100000
	help
	  Also sent in PBKDFParamResponse. Costs the COMMISSIONER time, not this
	  device: the verifier is derived off-device, so a high count is paid by
	  the phone once per pairing, in milliseconds.

if TINYTALK_BLE

config TINYTALK_BLE_RX_BUF
	int "Inbound Matter message ceiling, bytes"
	default 1024
	help
	  Size of the BTP reassembly area, and therefore the largest message
	  this node will accept. A peer declaring more than this in its Start
	  fragment is refused before a byte is copied, so setting it low costs
	  compatibility, never memory safety.

config TINYTALK_BLE_WINDOW
	int "Largest BTP receive window we will grant"
	default 4
	range 2 8

module = TINYTALK_BLE
module-str = matter_ble
source "subsys/logging/Kconfig.template.log_config"

endif # TINYTALK_BLE

# Thread logs separately: matter_thread_port.c narrates SRP registration; the
# node's own log carries commissioning and fabric handling.
if TINYTALK_THREAD
module = TINYTALK_THREAD
module-str = matter_thread
source "subsys/logging/Kconfig.template.log_config"
endif # TINYTALK_THREAD

endif # TINYTALK
```
