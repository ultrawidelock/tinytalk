## CMakeLists.txt
```
cmake_minimum_required(VERSION 3.20.0)

# tinymatter is the Zephyr module two directories up.
list(APPEND ZEPHYR_EXTRA_MODULES ${CMAKE_CURRENT_SOURCE_DIR}/../..)

find_package(Zephyr REQUIRED HINTS $ENV{ZEPHYR_BASE})
project(tinymatter_door_lock)

target_sources(app PRIVATE src/main.c)

# The manual pairing code, for the boot log. scripts/spake2p_verifier.py
# re-derives the verifier from the passcode in this build's .config first, and
# the build stops if the two disagree: a code that does not match the verifier
# fails at Pake3 looking exactly like a typo.
execute_process(
  COMMAND ${PYTHON_EXECUTABLE} ${CMAKE_CURRENT_SOURCE_DIR}/../../scripts/spake2p_verifier.py
          --from-config ${DOTCONFIG}
  OUTPUT_VARIABLE TM_PAIRING_OUT
  ERROR_VARIABLE TM_PAIRING_ERR
  RESULT_VARIABLE TM_PAIRING_RC)
if(NOT TM_PAIRING_RC EQUAL 0)
  message(FATAL_ERROR "${TM_PAIRING_OUT}${TM_PAIRING_ERR}")
endif()
string(REGEX MATCH "setup code  ([0-9]+-[0-9]+-[0-9]+)" TM_PAIRING_MATCH "${TM_PAIRING_OUT}")
if(NOT CMAKE_MATCH_1)
  message(FATAL_ERROR "no setup code in: ${TM_PAIRING_OUT}")
endif()
message(STATUS "tinymatter manual pairing code: ${CMAKE_MATCH_1}")
target_compile_definitions(app PRIVATE TM_SAMPLE_MANUAL_CODE="${CMAKE_MATCH_1}")
```

## prj.conf
```kconfig
# tinytalk door-lock sample: a Matter Door Lock on an nRF52833, commissioned
# over BLE, operated over Thread. Measured facts below were measured in
# ultrawidelock, on its DWM3001CDK image, on the dates given.

# ---- tinytalk ---------------------------------------------------------------
CONFIG_TINYTALK=y
CONFIG_TINYTALK_BLE=y
CONFIG_TINYTALK_THREAD=y
CONFIG_TINYTALK_DOOR_LOCK=y
CONFIG_GPIO=y
# The factory-reset press reboots.
CONFIG_REBOOT=y
# The fabric store and OpenThread keep their state in settings, on NVS.
CONFIG_FLASH=y
CONFIG_FLASH_MAP=y
CONFIG_NVS=y
CONFIG_SETTINGS=y
CONFIG_SETTINGS_NVS=y
# 16 KB, four NVS sectors: what the source image ran its fabrics, OpenThread and
# its reader keys in on hardware. The 8 KB default leaves one usable sector.
CONFIG_PM_PARTITION_SIZE_SETTINGS_STORAGE=0x4000
# The DWM3001CDK's devicetree enables its LIS2DH accelerometer; nothing here
# reads it.
CONFIG_LIS2DH=n
CONFIG_I2C=n
CONFIG_SIZE_OPTIMIZATIONS=y
# Link-time optimisation: 33,460 B less flash on the DWM3001CDK, measured
# 2026-10-16. The source project ran it on every Matter over Thread image and
# proved it on hardware on 2026-08-02, with a UWB walk-up unlock whose ranging
# path has a ~1836 us arm deadline.
#
# BOTH LINES ARE REQUIRED. `CONFIG_LTO=y` on its own is a silent no-op: the
# symbol depends on
#   !(GEN_ISR_TABLES || GEN_IRQ_VECTOR_TABLE) || ISR_TABLES_LOCAL_DECLARATION
# (zephyr/Kconfig.zephyr), and with that unmet Kconfig drops it from the
# generated .config without a warning. Grep the build's zephyr/.config for both
# before trusting a size.
#
# CONFIG_SIZE_OPTIMIZATIONS_AGGRESSIVE (-Oz) is a measured dead end: in the
# source project, 2026-08-22, it came out 1 byte smaller than -Os on this GCC,
# and -flto-partition=one bought nothing either.
CONFIG_LTO=y
CONFIG_ISR_TABLES_LOCAL_DECLARATION=y
CONFIG_HEAP_MEM_POOL_SIZE=4096
CONFIG_MAIN_STACK_SIZE=4096
# Measured 2026-08-02 from the stack paint, with the source's credential reader
# also on this queue: peak 3,872 B, and 4096 faulted. Not re-measured without it.
CONFIG_SYSTEM_WORKQUEUE_STACK_SIZE=6144

# ---- BLE: commissioning only ----------------------------------------------------
CONFIG_BT=y
CONFIG_BT_PERIPHERAL=y
CONFIG_BT_MAX_CONN=1
CONFIG_BT_MAX_PAIRED=0
CONFIG_BT_DEVICE_NAME="tinytalk"
# matter_ble_publish() registers and withdraws the 0xFFF6 service at runtime,
# so the GATT table matches the advert.
CONFIG_BT_GATT_DYNAMIC_DB=y
CONFIG_BT_GATT_CACHING=n
# An ATT MTU of 251: BTP fragments fit one PDU.
CONFIG_BT_L2CAP_TX_MTU=251
CONFIG_BT_BUF_ACL_RX_SIZE=255
CONFIG_BT_BUF_ACL_TX_SIZE=251
CONFIG_BT_EATT=n
# Ask for 15-30 ms, no latency, 2 s supervision, 300 ms after connecting. The
# timeout is the lever: Zephyr sends the PREF values when it fires. Measured
# 2026-08-06: an iPhone grants 30 ms whatever it is asked, but keeps the 2 s
# supervision instead of Zephyr's 420 ms default.
CONFIG_BT_CONN_PARAM_UPDATE_TIMEOUT=300
CONFIG_BT_PERIPHERAL_PREF_MIN_INT=12
CONFIG_BT_PERIPHERAL_PREF_MAX_INT=24
CONFIG_BT_PERIPHERAL_PREF_LATENCY=0
CONFIG_BT_PERIPHERAL_PREF_TIMEOUT=200

# ---- crypto: PSA on nrf_oberon (the nRF52833 has no CryptoCell) ---------------
CONFIG_NRF_SECURITY=y
CONFIG_MBEDTLS_PSA_CRYPTO_C=y
CONFIG_MBEDTLS_ENABLE_HEAP=y
# Measured peak across boot, PASE and CASE: 228 B. 512 broke Matter over
# Thread on 2026-08-03: OpenThread's SRP key is a PERSISTENT PSA key, and
# generating one failed with PSA_ERROR_INSUFFICIENT_MEMORY. The node then
# commissions, attaches, and never registers its name.
CONFIG_MBEDTLS_HEAP_SIZE=1024
# PSA persistent-key storage stays on (the default) for the same reason.
CONFIG_PSA_WANT_ALG_ECDSA=y
CONFIG_PSA_WANT_ALG_ECDH=y
CONFIG_PSA_WANT_KEY_TYPE_ECC_KEY_PAIR_GENERATE=y
CONFIG_PSA_WANT_KEY_TYPE_ECC_KEY_PAIR_IMPORT=y
CONFIG_PSA_WANT_KEY_TYPE_ECC_KEY_PAIR_EXPORT=y
CONFIG_PSA_WANT_KEY_TYPE_ECC_KEY_PAIR_DERIVE=y
CONFIG_PSA_WANT_KEY_TYPE_ECC_PUBLIC_KEY=y
CONFIG_PSA_WANT_ECC_SECP_R1_256=y
CONFIG_PSA_WANT_ALG_SHA_256=y
CONFIG_PSA_WANT_ALG_ECB_NO_PADDING=y
CONFIG_PSA_WANT_KEY_TYPE_AES=y
CONFIG_PSA_WANT_GENERATE_RANDOM=y

# ---- Thread: an OpenThread MTD ----------------------------------------------------
CONFIG_OPENTHREAD=y
CONFIG_OPENTHREAD_MTD=y
CONFIG_OPENTHREAD_SRP_CLIENT=y
CONFIG_OPENTHREAD_SLAAC=y
# The node starts Thread when a commissioner hands it a dataset.
CONFIG_OPENTHREAD_MANUAL_START=y
# The Interaction Model runs on this stack. The 3,168 B default overflowed at
# CommissioningComplete; measured peak after a complete pairing: 3,072 B.
CONFIG_OPENTHREAD_THREAD_STACK_SIZE=4096
# Nothing calls otPing* or otInstanceGetUptime*: 936 B of dead text.
CONFIG_OPENTHREAD_PING_SENDER=n
CONFIG_OPENTHREAD_UPTIME=n

# ---- logging: RTT, the board's only console ---------------------------------------
CONFIG_UART_CONSOLE=n
CONFIG_LOG=y
CONFIG_LOG_MODE_MINIMAL=y
CONFIG_LOG_DEFAULT_LEVEL=3
CONFIG_BT_LOG_LEVEL_WRN=y
CONFIG_USE_SEGGER_RTT=y
CONFIG_RTT_CONSOLE=y
# Boot output exceeds the 1 KB default, and a full buffer silently drops.
CONFIG_SEGGER_RTT_BUFFER_SIZE_UP=8192
```

## overlay-lto.conf
```kconfig
# Link-time optimisation for the door-lock sample. Add it with
#   -DEXTRA_CONF_FILE="overlay-thread.conf;overlay-lto.conf"
#
# CARRIED FROM THE SOURCE PROJECT (see NOTICE), where it applied by default to
# every Matter over Thread image. Its numbers were measured there.
#
# BOTH LINES ARE REQUIRED, and this is the trap worth knowing. `CONFIG_LTO=y` on
# its own is a silent no-op: the symbol depends on
#   !(GEN_ISR_TABLES || GEN_IRQ_VECTOR_TABLE) || ISR_TABLES_LOCAL_DECLARATION
# (zephyr/Kconfig.zephyr:526-528). With that dependency unmet Kconfig does not
# merely leave LTO off, it drops the symbol from the generated .config entirely,
# and emits no warning while doing it. Never trust a size number from this
# overlay without grepping the build's zephyr/.config for BOTH symbols.
#
# WHY IT WAS GATED, and what cleared the gate. LTO is whole-program codegen on
# an image whose UWB ranging path has a ~1836 us arm deadline, and a smaller
# binary is no evidence whatever that the deadline still holds. The only check
# that could prove it is a walk-up unlock on hardware.
#
# That ran 2026-08-02 on the debug image (405,296 B flash, 123,752 B RAM): two
# grants, a relock at 336 cm once past the 250 cm departure gate, a re-grant on
# the return leg at 45 cm, and 604 RX with the STS live throughout. Distance
# tracked unbroken from 1 cm to 584 cm and back. Re-run that walk-up after any
# change that could move the ranging path, not just after changes to this file.
CONFIG_LTO=y
CONFIG_ISR_TABLES_LOCAL_DECLARATION=y

# CONFIG_SIZE_OPTIMIZATIONS_AGGRESSIVE (-Oz) is NOT set, and that is a
# measured dead end rather than an oversight: tried 2026-08-22 on the
# debug+client image at 467b9f3a, it produced a binary exactly 1 byte
# smaller than -Os. On this GCC (12.2, arm-zephyr-eabi) -Oz's cost-model
# changes are almost entirely x86-side, so under LTO the two levels are the
# same codegen here. -flto-partition=one was measured in the same session
# and bought nothing attributable either. Do not re-spend a build on them.
```

## overlay-thread.conf
```kconfig
# Thread for the door-lock sample: an OpenThread MTD beside BLE.
#
# Build with:
#   west build -b decawave_dwm3001cdk samples/door-lock -- \
#     -DEXTRA_CONF_FILE=overlay-thread.conf
#
# CARRIED FROM THE SOURCE PROJECT (see NOTICE), comments included. Every number
# below was measured there, on its reader + Matter image, on the date given;
# this sample's own sizes are in README.md.

CONFIG_TINYMATTER_THREAD=y

# MEASURED in the source project on nRF52833, reader + five-fabric Matter node +
# Thread MTD, SMP=1 RELEASE=1, 2026-08-16, from the linker's own region report:
#
#   flash      397,360 B   91.63% of the 433,664 B app region;  36,304 B free
#   RAM        120,740 B   92.12% of 131,072 B;                 10,332 B free
#
# The standalone-OpenThread optimization that introduced this overlay measured:
#
#   417,308 / 121,236   the L2 image at LOG_DEFAULT_LEVEL=3  (flash bound, 96.23%)
#   396,740 / 121,044   errors-only logging                  (flash bound, 91.49%)
#   379,356 / 111,012   standalone OpenThread, 2026-08-04    (RAM bound, 84.70%)
#
# Standalone OpenThread is worth 17,384 B of flash and 10,032 B of RAM against
# that historical middle row. The RAM half was the interesting one: 4,540 B of it is named
# .bss pools that simply stopped existing (see the reclamation section below),
# and the rest is the L2's own thread, net_if state and neighbour tables.
#
# The figure that stood here for a long time was 415,416 B / 80.5% against a
# 516,096 B slot. Both halves of that are now wrong: the slot shrank when
# MCUboot arrived, and the image had already grown ~29 KB past 415,416 B before
# it did. It was measured on a smaller tree and was never updated, which cost a
# planning round -- 80% and 92% are different decisions. Re-measure from the
# linker's own region report, not from this comment: the exact figures above
# move by roughly a kilobyte on every merge into this branch, so treat them as
# a snapshot with a date, not as a fact about the code.

# ---- the stack ------------------------------------------------------------
#
# STANDALONE OpenThread, not NET_L2_OPENTHREAD. The L2 exists to carry Zephyr's
# IPv6 stack over a Thread interface, and this node never asks it to: every
# datagram in and out of matter_thread_port.c goes through otUdpSend and an
# otUdpSocket receive callback, and CONFIG_NET_SOCKETS has been n since the
# overlay was written. The whole IP layer was being linked to serve nobody.
#
# What makes it work without the L2, verified in this NCS 3.3.0 workspace:
#   - nrf/modules/openthread/platform/CMakeLists.txt:22 selects radio_nrf5.c
#     with zephyr_library_sources_ifndef(CONFIG_NET_L2_OPENTHREAD), so the
#     radio driver is Nordic's own rather than the L2 adaptation layer.
#   - zephyr/modules/openthread/openthread.c provides openthread_run(),
#     openthread_mutex_lock/unlock() and openthread_get_default_instance(),
#     the only four Zephyr-side OT calls this firmware makes. The L2 header
#     marks its versions @deprecated in favour of exactly these.
#   - OPENTHREAD_SYS_INIT defaults y and depends on !NET_L2_OPENTHREAD, so the
#     stack still initialises; MANUAL_START below still governs when it joins.
CONFIG_OPENTHREAD=y
CONFIG_OPENTHREAD_MTD=y
# MED, not SED. This used to be CONFIG_OPENTHREAD_MTD_SED=y with
# CONFIG_OPENTHREAD_POLL_PERIOD=3000, and that pair was the single largest
# share of tile-tap latency and of commissioning's post-BLE tail: an SED
# receives a frame only when it polls, so every hub-to-node message -- each
# CASE sigma, every tile invoke, every subscription chunk ack -- waited a mean
# 1,500 ms, and the SII=3000 the node advertised alongside it paced every
# peer retransmit at 3.3 s or more.
#
# Keeping the receiver on is pre-cleared on this exact part: the Stage 0
# contention gate (src/thread_gate.c) deliberately ran MED on channel 15
# directly over BLE ch38 under ping load, and ranging survived. The board is
# USB-powered, so rx-on costs power nothing here pays for and buys latency.
#
# If a battery build ever needs SED back: CONFIG_OPENTHREAD_MTD_SED=y plus
# CONFIG_OPENTHREAD_POLL_PERIOD=500, and move the advertised SII with it --
# the SRP TXT record (ports/zephyr/thread/matter_thread_port.c) and the Sigma2
# session parameters (src/matter_case.c) describe this radio's
# availability to peers, and the three lie if they diverge.

# Matter over Thread registers its operational service with the border router
# over SRP, so this is not optional once CASE has to be reachable.
CONFIG_OPENTHREAD_SRP_CLIENT=y

# Stateless address autoconfiguration. Defaults OFF, and without it this node
# holds ONLY mesh-local and link-local addresses -- so a commissioner resolves
# its SRP name, gets an address that does not leave the Thread mesh, and hangs.
# Measured exactly that: attached as a child in 2,500 ms, then twenty seconds
# with no off-mesh-routable address, because SLAAC is what builds one from the
# prefix the border router publishes. Nothing about being ON a network makes a
# node REACHABLE on it.
CONFIG_OPENTHREAD_SLAAC=y

# Do NOT bring Thread up at boot. This node has no dataset until Apple sends
# one, and a stack that starts without credentials scans, fails, and retries
# for the whole commissioning window -- on a radio BLE is sharing.
# matter_thread_start() starts it, the moment there is something to start with.
CONFIG_OPENTHREAD_MANUAL_START=y

# 2048 here faults during the UNLOCK, immediately after SENT_AUTH0: the credential
# access protocol runs on this queue and its measured peak is 3,568 B. The trim
# was withdrawn once and came back in this overlay -- it cannot go below 4096.
#
# 4096 THEN FAULTED THE SAME WAY on 2026-08-02, same phase, same MPU stack
# guard, once Matter ran alongside the unlock: an operational node persists the
# trust store and services a subscription on this queue while the access
# protocol is mid-AUTH0, and 528 B of headroom did not cover the overlap.
# MEASURED 2026-08-02 from the stack paint, after a full-auth walk-up unlock on
# a commissioned node: PEAK 3,872 B of the 6,144 here, 2,272 B untouched.
# So 4096 was never comfortably right -- it left 224 B, and the two faults were
# that margin being spent by whatever else the queue was doing at the time.
# 6144 is kept rather than trimmed to ~5120 because the peak MOVES with what
# overlaps the unlock, and this is the stack that has already faulted twice.
CONFIG_SYSTEM_WORKQUEUE_STACK_SIZE=6144
CONFIG_MAIN_STACK_SIZE=4096

# TEMPORARY, for sizing the stack above. Paint only -- no analyzer thread.
#
# CONFIG_THREAD_ANALYZER_AUTO was the obvious way to read the peak and costs a
# thread and its stack, which took this image to 96.6% RAM against a 127,352 B
# figure already recorded as unrunnable. The paint is what the analyzer
# actually measures, and a debugger can read it straight out of RAM:
#
#   savebin stack.bin, <stack addr>, <size>   # addresses from zephyr.map
#   then count the leading 0xAA run; peak used = size - run
#
# So this keeps the fill, which costs nothing at runtime, and leaves the
# reading to the host. Drop CONFIG_INIT_STACKS once the number is settled.
CONFIG_INIT_STACKS=y

# The Matter Interaction Model runs on THIS stack. Datagrams arrive through the
# OpenThread UDP callback, so decrypt, decode, the cluster command, the response
# encode and the framing all happen on ot_work_q -- and at 3168 B (the NCS
# default) it overflowed at CommissioningComplete, twice, with both fabrics
# accepted and both CASE sessions up. "Stack overflow on CPU 0", a halt, and the
# phone reporting "transaction timed out" for a pairing that had in fact
# succeeded on the wire.
#
# Moving the NVS write off this thread was necessary and NOT sufficient: the IM
# path alone does not fit.
#
# MEASURED from the paint after a COMPLETE pairing -- two fabrics, two CASE
# sessions, a chunked subscription and both credentials: PEAK 3,072 B of
# the 4,096 here, 1,024 B untouched.
#
# So the 3168 default was not badly wrong, it was wrong by NINETY-SIX BYTES.
# That is the whole story of this fault: a margin thin enough that any variation
# in the path spends it, which is why the same firmware paired once and then
# halted twice in the same place. The system work queue earlier the same day was
# the same shape (3,872 B measured against 4,096 allowed). On this part a
# default is a starting point, not a size.
CONFIG_OPENTHREAD_THREAD_STACK_SIZE=4096

# ---- what is left out -----------------------------------------------------
#
# Zephyr's IP stack, entirely. This block used to read "sockets sit above UDP
# and a Matter node calling otUdp* never touches them; UDP itself has to stay,
# because connection.c compiles under NET_IPV6 and its CONFIG_NET_MAX_CONN
# depends on a transport". That was true while NET_L2_OPENTHREAD forced
# NETWORKING on. Dropping the L2 drops the premise: no NETWORKING, so no
# NET_IPV6, no NET_UDP, no NET_SOCKETS and no connection.c to satisfy. The
# symbols are not set to n here because without NETWORKING they do not exist,
# and assigning an undefined symbol is a Kconfig warning that reads like a
# setting and behaves like a comment.

# The source image's USB provisioning console was switched off here too; its
# symbol does not exist in this sample.
CONFIG_SHELL=n
CONFIG_USB_DEVICE_STACK=n
CONFIG_USB_CDC_ACM=n

# ---- RAM reclamation ------------------------------------------------------
#
# Zephyr's net buffers were trimmed here from the general-IP-routing defaults,
# worth 3,744 B while the L2 was carrying datagrams. Standalone OpenThread
# retires the pools outright rather than shrinking them: measured in the
# 2026-08-04 baseline ELF, net_buf_data_pkt_pool 1,024 + net_buf_data_rx_bufs
# 1,024 + net_buf_data_tx_bufs 1,024 + _k_mem_slab_buf_tx_pkts 832 +
# _k_mem_slab_buf_rx_pkts 624 + ipv6_addresses 588 + _net_buf_rx_bufs 224 +
# _net_buf_tx_bufs 224 = 5,564 B of .bss that no longer has an owner.
# OpenThread carries its own message pool and is unaffected.

# CONFIG_MBEDTLS_HEAP_SIZE was on this list as "do not touch, starving it
# breaks unlocks on a path nothing exercises". It has since been MEASURED at a
# 228 B peak and now sits at 1024 in prj.conf, which is where the argument
# should have started. The caution was right about the unlock path and wrong
# about the size: measure first, and the number settles it. It went 16384 ->
# 4096 -> 1024, each step against a measurement rather than a guess.
#
# DELIBERATELY NOT REDUCED:
#
#   OpenThread and net stacks     ~2,800 B, paid for with an MPU stack-guard
#                                 fault under load -- which on this board has
#                                 already once presented as a hang. Size these
#                                 from CONFIG_THREAD_ANALYZER_AUTO, never by
#                                 estimate; two stacks in this project were
#                                 guessed low and both faulted on hardware.
#   CONFIG_NRF_802154_RX_BUFFERS  default 20, 2,580 B measured (129 B each). A
#                                 1,024 B Sigma3 arrives as ~11-12 6LoWPAN
#                                 fragments, so cutting to 8 would leave less
#                                 than one CASE message of margin on a radio
#                                 the OT thread shares with BLE and the DW3110
#                                 ISR queue.
#   OPENTHREAD_NUM_MESSAGE_BUFFERS  IMPOSSIBLE, not merely unwise. NCS pins it
#                                 at `range 64 65535` for an MTD
#                                 (nrf/subsys/net/openthread/Kconfig.defconfig)
#                                 and 64 is already the effective value, so a
#                                 lower setting aborts the build.

# Two OpenThread modules nothing in this image calls, compiled in only because
# somebody else's default said yes: the NCS defconfig turns the ping sender on
# (nrf/subsys/net/openthread/Kconfig.defconfig:90) and OPENTHREAD_UPTIME
# defaults y for every MTD build. Both are ot::Instance members, so LTO and
# --gc-sections can never drop them on their own. 936 B of text measured dead
# at 467b9f3a: no caller for otPing* or otInstanceGetUptime* exists outside
# workspace/. Nothing observable changes -- neither has a log line to lose.
CONFIG_OPENTHREAD_PING_SENDER=n
CONFIG_OPENTHREAD_UPTIME=n

# Frame security in OpenThread's sub-MAC instead of inside the 802.15.4
# driver. Not a feature cut: OT_RADIO_CAPS_TRANSMIT_SEC is only ever a
# routing decision (ieee802154_nrf5.c:261 -> radio.c:1002), and the software
# path is ALREADY compiled into every one of these images --
# OPENTHREAD_MAC_SOFTWARE_TX_SECURITY_ENABLE=y above it. With the driver
# copy gone the same AES-CCM runs once instead of linking twice: 868 B of
# driver-side crypto measured at 467b9f3a. The price is software CCM ahead
# of each secured TX on the OT thread rather than in the radio ISR path,
# which an MTD sending data polls and the odd SRP update will not notice.
# Verify like any radio-path change: Thread must still attach and pass
# Stage 1 of the source project's Matter binding bench before this ships anywhere.
CONFIG_NRF_802154_ENCRYPTION=n
```

## src/main.c
```c
/* SPDX-License-Identifier: ISC */

/*
 * tinytalk door-lock sample.
 *
 * Boot order, learned from the source project's commissioning glue:
 *
 *   1. PSA Crypto, then settings: the fabric store and OpenThread keep their
 *      state there, and the node signs and derives with PSA.
 *   2. Bluetooth, then the Matter node (matter_commission_init), which restores
 *      any stored fabric and, with Thread, rejoins the network.
 *   3. Advertise the 0xFFF6 commissionable service while there is no fabric.
 *
 * From there the commissioner drives it: PASE over BLE, the fabric added over
 * CASE, then the Thread attach and the SRP registration, both done by the node
 * and ports/zephyr/thread.
 *
 * The Door Lock cluster (clusters/door_lock) sits on endpoint 1 and drives
 * LED0: on while unlocked. Button 0: a short
 * press opens a basic commissioning window for WINDOW_S seconds; a press held
 * for FACTORY_RESET_MS erases the stored fabrics and reboots.
 */
#include <zephyr/bluetooth/bluetooth.h>
#include <zephyr/bluetooth/conn.h>
#include <zephyr/drivers/gpio.h>
#include <zephyr/fs/nvs.h>
#include <zephyr/kernel.h>
#include <zephyr/logging/log.h>
#include <zephyr/settings/settings.h>
#include <zephyr/sys/reboot.h>

#include <psa/crypto.h>

#include <tinytalk/matter_commission.h>
#include <tinytalk/matter_fab_store.h>
#include <tinytalk/matter_thread.h>
#include <tinytalk/tm_door_lock.h>

#include "matter_ble_zephyr.h"

LOG_MODULE_REGISTER(door_lock, LOG_LEVEL_INF);

#define WINDOW_S         900u
#define FACTORY_RESET_MS 5000
#define SRP_RETRACT_MS   2000

static const struct matter_commission_config s_matter_cfg = {
	.vendor_id = CONFIG_TINYTALK_VENDOR_ID,
	.product_id = CONFIG_TINYTALK_PRODUCT_ID,
	.verifier_hex = CONFIG_TINYTALK_SPAKE2P_VERIFIER,
	.salt_hex = CONFIG_TINYTALK_SPAKE2P_SALT,
	.iterations = CONFIG_TINYTALK_SPAKE2P_ITERATIONS,
	.product_name = "tinytalk door lock",
	.hardware_version = 1u,
	.software_version = 1u,
	.endpoints = &tm_door_lock_endpoint,
	.n_endpoints = 1u,
};

static const struct gpio_dt_spec s_led = GPIO_DT_SPEC_GET(DT_ALIAS(led0), gpios);
static const struct gpio_dt_spec s_button = GPIO_DT_SPEC_GET(DT_ALIAS(sw0), gpios);

/* ---- advertising ------------------------------------------------------------
 *
 * The node asks for this through matter_commission_readvertise() with its own
 * lock held, so the work is done here, on the system work queue.
 */
static uint8_t s_svc_data[MATTER_BLE_SVC_DATA_LEN];

static void adv_work_fn(struct k_work *work)
{
	bool want = !matter_commission_has_fabric() || matter_commission_window_open();
	const struct bt_data ad[] = {
		BT_DATA_BYTES(BT_DATA_FLAGS, BT_LE_AD_GENERAL | BT_LE_AD_NO_BREDR),
		BT_DATA(BT_DATA_SVC_DATA16, s_svc_data, sizeof(s_svc_data)),
	};
	int rc;

	ARG_UNUSED(work);
	/* The GATT table follows the advert: no commissioning service while the
	 * node is not offering to be commissioned. -EBUSY means a link is up and
	 * the next pass will try again. */
	(void)matter_ble_publish(want);
	(void)bt_le_adv_stop();
	if (!want) {
		return;
	}
	if (matter_ble_commissionable_svc_data(s_svc_data, sizeof(s_svc_data)) != 0) {
		LOG_ERR("no commissionable payload");
		return;
	}
	rc = bt_le_adv_start(BT_LE_ADV_PARAM(BT_LE_ADV_OPT_CONN, BT_GAP_ADV_FAST_INT_MIN_2,
					     BT_GAP_ADV_FAST_INT_MAX_2, NULL),
			     ad, ARRAY_SIZE(ad), NULL, 0);
	if (rc != 0 && rc != -EALREADY) {
		LOG_ERR("advertising failed (%d)", rc);
	}
}
static K_WORK_DEFINE(s_adv_work, adv_work_fn);

void matter_commission_readvertise(void)
{
	k_work_submit(&s_adv_work);
}

/* A connection stops connectable advertising; the next one starts when the
 * connection object is free again. */
static void on_recycled(void)
{
	k_work_submit(&s_adv_work);
}

/* Every link, not only the one that writes C1: a peer that connects and never
 * writes shows up nowhere else. */
static void on_connected(struct bt_conn *conn, uint8_t err)
{
	char addr[BT_ADDR_LE_STR_LEN];

	bt_addr_le_to_str(bt_conn_get_dst(conn), addr, sizeof(addr));
	LOG_INF("BLE connected: %s (err 0x%02x)", addr, err);
}

static void on_disconnected(struct bt_conn *conn, uint8_t reason)
{
	ARG_UNUSED(conn);
	LOG_INF("BLE disconnected (0x%02x)", reason);
}

BT_CONN_CB_DEFINE(s_conn_cb) = {
	.connected = on_connected,
	.disconnected = on_disconnected,
	.recycled = on_recycled,
};

/* ---- the bolt ---------------------------------------------------------------- */

void tm_door_lock_actuate(uint8_t lock_state)
{
	(void)gpio_pin_set_dt(&s_led, lock_state == MATTER_DL_LOCK_STATE_UNLOCKED);
	LOG_INF("door %s", lock_state == MATTER_DL_LOCK_STATE_UNLOCKED ? "unlocked" : "locked");
}

/* ---- the button --------------------------------------------------------------- */

static struct gpio_callback s_button_cb;
/* -1 until this boot sees a press: the press held through a factory-reset
 * reboot ends here as a bare release, which is not a short press. */
static int64_t s_pressed_at = -1;

static void reboot_fn(struct k_work *work)
{
	ARG_UNUSED(work);
	/* The fabric erase is logical: the old records, operational keys among
	 * them, stay in NVS until garbage collection, and OpenThread's dataset,
	 * network key and SRP key are not the node's to erase. Clearing the
	 * settings store takes all of it, PSA's stored keys included. */
	void *storage;

	if (settings_storage_get(&storage) == 0) {
		(void)nvs_clear(storage);
	}
	sys_reboot(SYS_REBOOT_COLD);
}
static K_WORK_DELAYABLE_DEFINE(s_reboot_work, reboot_fn);

/* The SRP records are retracted before the reboot: the border router otherwise
 * keeps advertising them for their lease (2 h asked for), and Apple Home dials
 * a stale commissionable record over Thread instead of using BLE. It connects
 * and never writes C1 (2026-10-16, dns-sd -B _matterc._udp). LED0 stays lit
 * while the removal goes out, so the reset is visible. */
static void factory_reset_fn(struct k_work *work)
{
	ARG_UNUSED(work);
	if (gpio_pin_get_dt(&s_button) != 1) {
		return;
	}
	LOG_WRN("button held: factory reset");
	(void)gpio_pin_set_dt(&s_led, 1);
	(void)matter_fab_erase();
#if defined(CONFIG_TINYTALK_THREAD)
	matter_thread_advertise_reset();
#endif
	(void)k_work_reschedule(&s_reboot_work, K_MSEC(SRP_RETRACT_MS));
}
static K_WORK_DELAYABLE_DEFINE(s_factory_reset_work, factory_reset_fn);

static void open_window_fn(struct k_work *work)
{
	ARG_UNUSED(work);
	if (matter_commission_open_window(WINDOW_S) == 0) {
		LOG_INF("commissioning window open for %u s", WINDOW_S);
	} else {
		LOG_INF("commissioning window already open");
	}
}
static K_WORK_DEFINE(s_open_window_work, open_window_fn);

static void on_button(const struct device *dev, struct gpio_callback *cb, uint32_t pins)
{
	ARG_UNUSED(dev);
	ARG_UNUSED(cb);
	ARG_UNUSED(pins);
	if (gpio_pin_get_dt(&s_button) == 1) {
		s_pressed_at = k_uptime_get();
		(void)k_work_reschedule(&s_factory_reset_work, K_MSEC(FACTORY_RESET_MS));
		return;
	}
	(void)k_work_cancel_delayable(&s_factory_reset_work);
	if (s_pressed_at >= 0 && k_uptime_get() - s_pressed_at < FACTORY_RESET_MS) {
		k_work_submit(&s_open_window_work);
	}
	s_pressed_at = -1;
}

static int button_init(void)
{
	int rc;

	if (!gpio_is_ready_dt(&s_button)) {
		return -ENODEV;
	}
	rc = gpio_pin_configure_dt(&s_button, GPIO_INPUT);
	if (rc == 0) {
		rc = gpio_pin_interrupt_configure_dt(&s_button, GPIO_INT_EDGE_BOTH);
	}
	if (rc == 0) {
		gpio_init_callback(&s_button_cb, on_button, BIT(s_button.pin));
		rc = gpio_add_callback(s_button.port, &s_button_cb);
	}
	return rc;
}

int main(void)
{
	int rc;

	if (gpio_is_ready_dt(&s_led)) {
		(void)gpio_pin_configure_dt(&s_led, GPIO_OUTPUT_INACTIVE);
	}
	if (button_init() != 0) {
		LOG_WRN("no button: commissioning window and factory reset unavailable");
	}

	if (psa_crypto_init() != PSA_SUCCESS) {
		LOG_ERR("PSA Crypto did not start");
		return 0;
	}
	rc = settings_subsys_init();
	if (rc != 0) {
		LOG_ERR("settings did not start (%d)", rc);
		return 0;
	}
	rc = bt_enable(NULL);
	if (rc != 0) {
		LOG_ERR("Bluetooth did not start (%d)", rc);
		return 0;
	}
	rc = matter_commission_init(&s_matter_cfg);
	if (rc != 0) {
		LOG_ERR("Matter node did not start (%d)", rc);
		return 0;
	}

	LOG_INF("manual pairing code %s, discriminator 0x%03x", TM_SAMPLE_MANUAL_CODE,
		CONFIG_TINYTALK_DISCRIMINATOR);
	matter_commission_readvertise();
	return 0;
}
```
